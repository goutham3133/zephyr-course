## Kconfig
```
mainmenu "LED Blink Application"

menuconfig LED_SUBSYSTEM
    bool "LED SUBSYSTEM"
    default y
 

if LED_SUBSYSTEM

choice BLINK_SLEEP
    prompt "LED blink speed"
    default BLINK_1000MS

    help
      Select the blink period for the LEDs.

config BLINK_250MS
    bool "250 ms"

config BLINK_500MS
    bool "500 ms"

config BLINK_1000MS
    bool "1000 ms"

config BLINK_2000MS
    bool "2000 ms"

endchoice


# Hidden int — never set by user, derived from choice above
config BLINK_TIME_MS
    int
    default 250  if BLINK_250MS
    default 500  if BLINK_500MS
    default 1000 if BLINK_1000MS
    default 2000 if BLINK_2000MS
    default 0    
    help
      The blink time in milliseconds, derived from the BLINK_SLEEP choice.

# --------------------------------------------------
# Advanced settings
# --------------------------------------------------

menuconfig ADVANCED_LED_SETTINGS
    bool "Advanced LED Settings"
    default n


if ADVANCED_LED_SETTINGS

config LED_BRIGHTNESS
    int "LED brightness level"
    default 100
    range 0 100
    help
      Set the brightness level for the LEDs (0-100%).

config LED_FADE_DURATION
    int "LED fade duration (ms)"
    default 300
    range 0 5000
    help
      Set the duration for LED fade effects in milliseconds.

# --------------------------------------------------
# Expert settings
# --------------------------------------------------

menu "EXPERT SETTINGS"
   visible if ADVANCED_LED_SETTINGS

config Enable_LED_DEBUGGING
    bool "LED diagnostics"

config Enable_Custom_LED_PATTERNS
    bool "Custom LED patterns"


endmenu # EXPERT_SETTINGS

endif # ADVANCED_LED_SETTINGS

endif # LED_SUBSYSTEM



source "Kconfig.zephyr"
```

## prj.conf
```kconfig
CONFIG_GPIO=y
CONFIG_LOG=y
CONFIG_SERIAL=y
CONFIG_UART_CONSOLE=y
CONFIG_PRINTK=y

# Disable RTT log backend to avoid conflict with Tracealyzer RTT
CONFIG_LOG_BACKEND_RTT=n

# Tracealyzer
CONFIG_TRACING=y
CONFIG_PERCEPIO_TRACERECORDER=y
CONFIG_USE_SEGGER_RTT=y
CONFIG_SEGGER_RTT_BUFFER_SIZE_UP=4096

# Blink time in milliseconds
#CONFIG_BLINK_TIME_MS=500
CONFIG_BLINK_1000MS=y
```

## boards/blue.overlay
```dts
/ {
    aliases {
        app-led = &blue_led;
    };
};
```

## boards/green.overlay
```dts
/ {
    aliases {
        app-led = &green_led;
    };
};
```

## boards/red.overlay
```dts
/ {
    aliases {
        app-led = &red_led;
    };
};
```

## src/main.cpp
```c
#include <zephyr/drivers/gpio.h>
#include <zephyr/kernel.h>
#include <zephyr/logging/log.h>

LOG_MODULE_REGISTER(led_app, LOG_LEVEL_INF);

#if !IS_ENABLED(CONFIG_LED_SUBSYSTEM)
#error "LED subsystem disabled"
#endif
//#define SLEEP_TIME_MS 1000

#define BLINK_TIME          CONFIG_BLINK_TIME_MS
#define LED_BRIGHTNESS      CONFIG_LED_BRIGHTNESS
#define LED_FADE            CONFIG_LED_FADE_DURATION

/* The devicetree node identifier for the "led0" alias. */


static const struct gpio_dt_spec led0 = GPIO_DT_SPEC_GET(DT_ALIAS(led0), gpios);
static const struct gpio_dt_spec led1 = GPIO_DT_SPEC_GET(DT_ALIAS(led1), gpios);

/* Stack sizes */
#define STACK_SIZE   512
#define PRIORITY_LED0  5
#define PRIORITY_LED1  6

/* ---- Task: blink LED0 at 500ms ---- */
void task_led0(void *p1, void *p2, void *p3)
{
    ARG_UNUSED(p1); ARG_UNUSED(p2); ARG_UNUSED(p3);

    if (!gpio_is_ready_dt(&led0))
    {
        return;
    }
    gpio_pin_configure_dt(&led0, GPIO_OUTPUT_INACTIVE);

    while (1) 
    {
        gpio_pin_toggle_dt(&led0);
        k_msleep(BLINK_TIME);
        if (IS_ENABLED(CONFIG_LED_DEBUGGING)) 
        {
        LOG_INF("LED0 toggle at %d ms", BLINK_TIME);
        }
        if (IS_ENABLED(CONFIG_LED_CUSTOM_PATTERNS)) 
        {
         // Example: different pattern
        gpio_pin_toggle_dt(&led0);
         k_msleep(BLINK_TIME * 10);
        }
    }
}

/* ---- Task: blink LED1 at 200ms ---- */
void task_led1(void *p1, void *p2, void *p3)
{
    ARG_UNUSED(p1); ARG_UNUSED(p2); ARG_UNUSED(p3);

    if (!gpio_is_ready_dt(&led1))
    {
        return;
    }

    gpio_pin_configure_dt(&led1, GPIO_OUTPUT_INACTIVE);

    while (1) 
    {
        gpio_pin_toggle_dt(&led1);
        k_msleep(BLINK_TIME / 5);
        if (IS_ENABLED(CONFIG_LED_DEBUGGING))
        {
        LOG_INF("LED1 toggle at %d ms", BLINK_TIME);
        }
        if (IS_ENABLED(CONFIG_LED_CUSTOM_PATTERNS)) 
        {
         // Example: different pattern
        gpio_pin_toggle_dt(&led1);
         k_msleep(BLINK_TIME / 10);
        }
    }
}

/* Static thread definitions — no main() needed to spawn these */
K_THREAD_DEFINE(led0_tid, STACK_SIZE, task_led0, NULL, NULL, NULL, PRIORITY_LED0, 0, 0);
//K_THREAD_DEFINE(led1_tid, STACK_SIZE, task_led1, NULL, NULL, NULL, PRIORITY_LED1, 0, 0);
```
