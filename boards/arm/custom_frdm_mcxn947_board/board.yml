## boards/arm/custom_frdm_mcxn947_board/board.yml
```yaml
board:
  name: custom_frdm_mcxn947_board
  full_name: CUSTOM_FRDM-MCXN947 BOARD
  vendor: goutham
  socs:
  - name: mcxn947
    variants:
    - name: qspi
      cpucluster: 'cpu0'
```

## boards/arm/scratch_mcxn947_board/Kconfig
```kconfig
# Copyright 2024 Custom
# SPDX-License-Identifier: Apache-2.0

config BOARD_SCRATCH_MCXN947_BOARD
        select BOARD_EARLY_INIT_HOOK
```

## boards/arm/scratch_mcxn947_board/Kconfig.defconfig
```kconfig
# Copyright 2024 Custom
# SPDX-License-Identifier: Apache-2.0

if BOARD_SCRATCH_MCXN947_BOARD

config NET_L2_ETHERNET
        default y if NETWORKING

endif # BOARD_SCRATCH_MCXN947_BOARD
```

## boards/arm/scratch_mcxn947_board/Kconfig.scratch_mcxn947_board
```kconfig
# Copyright 2024 Custom
# SPDX-License-Identifier: Apache-2.0

config BOARD_SCRATCH_MCXN947_BOARD
        select SOC_MCXN947_CPU0 if BOARD_SCRATCH_MCXN947_BOARD_MCXN947_CPU0
        select SOC_MCXN947_CPU1 if BOARD_SCRATCH_MCXN947_BOARD_MCXN947_CPU1
        select SOC_PART_NUMBER_MCXN947VDF
```

## boards/arm/scratch_mcxn947_board/board.yml
```yaml
board:
  name: scratch_mcxn947_board
  full_name: Scratch MCXN947 Board
  vendor: custom
  socs:
    - name: mcxn947
      variants:
        - name: cpu0
          cpucluster: 'cpu0'
        - name: cpu1
          cpucluster: 'cpu1'
```
